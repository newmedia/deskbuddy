#include "net.h"

#include <Arduino.h>
#include <ArduinoOTA.h>
#include <DNSServer.h>
#include <ESPmDNS.h>
#include <Preferences.h>
#include <Update.h>
#include <WebServer.h>
#include <WiFi.h>
#include <esp_heap_caps.h>
#include <esp_netif.h>
#include <esp_sntp.h>

#include "app.h"
#include "board/board.h"
#include "updater.h"
#include "web_index.h"  // generated by scripts/embed_web.py from web/index.html

namespace net {

namespace {

using Mode = buddy::DeviceInfo::WifiMode;

constexpr const char* kHost = "deskbuddy";
constexpr const char* kTz = "CET-1CEST,M3.5.0,M10.5.0/3";
constexpr uint32_t kConnectTimeout = 20000;   // ms before we fall back to the AP on first setup
constexpr uint32_t kApIdleTimeout = 600000;   // setup AP switches off after 10 min without visitors

buddy::App* app = nullptr;
WebServer server(80);
DNSServer dns;
Preferences prefs;

Mode mode = Mode::Off;
char ssid[33] = "", pass[65] = "";
char apName[24] = "";
uint32_t modeSince = 0, apLastClient = 0;
bool servicesUp = false, apUp = false, timeSynced = false, otaBusy = false;
uint8_t otaPct = 0;
void (*pumpFn)() = nullptr;  // keeps the screen (matrix + ring) moving during a blocking upload

void pumpNow() {
  static uint32_t last = 0;
  if (pumpFn && millis() - last >= 100) {  // ~10 fps: enough for the animation, the upload gets priority
    last = millis();
    pumpFn();
  }
}
// Connection attempt (for feedback in the setup page)
bool joining = false;
bool everConnected = false;   // has ever connected to the home network (then no setup AP on an outage)
uint32_t lastRetry = 0;
uint32_t joinStart = 0, staSince = 0;
int lastReason = 0;

const char* reasonText(int r) {
  switch (r) {
    case 2: case 15: case 202: case 204: return "wrong password";
    case 201: return "network not found (only 2.4 GHz is supported)";
    case 205: return "connection failed";
    case 0: return "";
    default: return "connection lost";
  }
}

void loadCreds() {
  prefs.begin("wifi", false);
  if (prefs.isKey("ssid")) prefs.getString("ssid", ssid, sizeof(ssid));
  if (prefs.isKey("pass")) prefs.getString("pass", pass, sizeof(pass));
  prefs.end();
}

void saveCreds() {
  prefs.begin("wifi", false);
  prefs.putString("ssid", ssid);
  prefs.putString("pass", pass);
  prefs.end();
}

void setMode(Mode m) {
  mode = m;
  modeSince = millis();
}

// ---------- web ----------

void jsonEscape(String& out, const char* s) {
  for (; *s; s++) {
    if (*s == '"' || *s == '\\') out += '\\';
    if ((uint8_t)*s >= 0x20) out += *s;
  }
}

void sendJson(int code, const String& body) {
  server.sendHeader("Cache-Control", "no-store");
  server.send(code, "application/json", body);
}

// Debug: log every request in setup mode (serial), to follow captive-portal behaviour.
void logReq(const char* what) {
  if (!apUp) return;
  Serial.printf("[web] %s %s%s -> %s  UA=\"%s\" Accept=\"%s\"\n", server.method() == HTTP_GET ? "GET" : "POST",
                server.hostHeader().c_str(), server.uri().c_str(), what, server.header("User-Agent").c_str(),
                server.header("Accept").c_str());
}

bool captiveRedirect() {
  // In AP mode, send every unknown domain to the setup page (captive portal).
  if (!apUp) return false;
  // Only requests arriving via the setup network; via the home network just serve the page.
  if (server.client().localIP() != WiFi.softAPIP()) return false;
  String host = server.hostHeader();
  if (host == WiFi.softAPIP().toString() || host.startsWith(kHost)) return false;
  server.sendHeader("Location", String("http://") + WiFi.softAPIP().toString() + "/", true);
  server.send(302, "text/plain", "");
  return true;
}

void sendCaptiveJson() {
  String ip = WiFi.softAPIP().toString();
  server.sendHeader("Cache-Control", "no-store");
  server.send(200, "application/captive+json",
              String("{\"captive\":") + (apUp ? "true" : "false") + ",\"user-portal-url\":\"http://" + ip + "/\"}");
}

void handleIndex() {
  logReq("index");
  if (captiveRedirect()) return;
  server.sendHeader("Content-Encoding", "gzip");
  server.sendHeader("Cache-Control", "no-cache");
  server.send_P(200, "text/html", (const char*)kIndexGz, kIndexGzLen);
}

void handleStatus() {
  char buf[640];
  app->statusJson(buf, sizeof(buf));
  sendJson(200, buf);
}

void handleCmd() {
  String line = server.hasArg("c") ? server.arg("c") : server.arg("plain");
  line.trim();
  static char* reply = (char*)heap_caps_malloc(700, MALLOC_CAP_SPIRAM);  // PSRAM: internal RAM is tight
  bool ok = app->command(line.c_str(), reply, 700);
  String body = String("{\"ok\":") + (ok ? "true" : "false") + ",\"reply\":\"";
  jsonEscape(body, reply);
  body += "\"}";
  sendJson(ok ? 200 : 400, body);
}

void handleScan() {
  int n = WiFi.scanComplete();
  if (n == WIFI_SCAN_FAILED) {
    WiFi.scanNetworks(true);
    sendJson(200, "{\"scanning\":true}");
    return;
  }
  if (n == WIFI_SCAN_RUNNING) {
    sendJson(200, "{\"scanning\":true}");
    return;
  }
  String body = "{\"scanning\":false,\"networks\":[";
  for (int i = 0; i < n; i++) {
    if (i) body += ',';
    body += "{\"ssid\":\"";
    jsonEscape(body, WiFi.SSID(i).c_str());
    body += "\",\"rssi\":" + String(WiFi.RSSI(i)) +
            ",\"open\":" + (WiFi.encryptionType(i) == WIFI_AUTH_OPEN ? "true" : "false") + "}";
  }
  body += "]}";
  WiFi.scanDelete();
  sendJson(200, body);
}

void handleWifiPost() {
  String s = server.arg("ssid"), p = server.arg("pass");
  if (s.isEmpty() || s.length() > 32 || p.length() > 64) {
    sendJson(400, "{\"ok\":false,\"reply\":\"invalid ssid or password\"}");
    return;
  }
  sendJson(200, "{\"ok\":true,\"reply\":\"connecting...\"}");
  delay(100);  // send the reply first
  join(s.c_str(), p.c_str());
}

void handleWifiState() {
  const char* st = "idle";
  bool connected = WiFi.status() == WL_CONNECTED;
  if (connected) st = "connected";
  else if (joining && (millis() - joinStart > 25000 || (lastReason && lastReason != 8))) st = "failed";
  else if (joining) st = "connecting";
  String body = String("{\"sta\":\"") + st + "\",\"ssid\":\"";
  jsonEscape(body, ssid);
  body += "\",\"ip\":\"" + (connected ? WiFi.localIP().toString() : String("")) + "\",\"reason\":\"";
  jsonEscape(body, connected ? "" : (millis() - joinStart > 25000 && !lastReason ? "no response from the network"
                                                                                    : reasonText(lastReason)));
  body += "\",\"switchIn\":" + String(connected && apUp && staSince ? (30 - (int)((millis() - staSince) / 1000)) : 0) + "}";
  sendJson(200, body);
}

void handleUpdateDone() {
  bool ok = !Update.hasError();
  sendJson(ok ? 200 : 500, ok ? "{\"ok\":true,\"reply\":\"updated, restarting...\"}"
                              : "{\"ok\":false,\"reply\":\"update failed\"}");
  if (ok) {
    delay(300);
    ESP.restart();
  }
  updateMemory(false);
  otaBusy = false;
}

}  // namespace

void updateMemory(bool updating) { heap_caps_malloc_extmem_enable(updating ? 4096 : 256); }

namespace {

void handleUpdateUpload() {
  HTTPUpload& up = server.upload();
  if (up.status == UPLOAD_FILE_START) {
    otaBusy = true;
    otaPct = 0;
    updateMemory(true);
    app->behaviour.command(buddy::Emotion::Neutral, 0);  // wake up right away, not only at the first pump
    Update.begin(UPDATE_SIZE_UNKNOWN);
    pumpNow();
  } else if (up.status == UPLOAD_FILE_WRITE) {
    Update.write(up.buf, up.currentSize);
    size_t total = server.clientContentLength();
    if (total) otaPct = (uint8_t)LV_MIN(99u, (unsigned)((uint64_t)up.totalSize * 100 / total));
    pumpNow();
  } else if (up.status == UPLOAD_FILE_END) {
    Update.end(true);
  } else if (up.status == UPLOAD_FILE_ABORTED) {
    Update.abort();
    updateMemory(false);
    otaBusy = false;
  }
}

void startServices() {
  if (servicesUp) return;
  servicesUp = true;
  static const char* hdrs[] = {"User-Agent", "Accept"};
  server.collectHeaders(hdrs, 2);
  server.on("/", HTTP_GET, handleIndex);
  server.on("/api/status", HTTP_GET, handleStatus);
  server.on("/captive", HTTP_GET, [] {
    logReq("captive-api");
    sendCaptiveJson();
  });
  server.on("/api/cmd", HTTP_POST, handleCmd);
  server.on("/api/wifi/scan", HTTP_GET, handleScan);
  server.on("/api/wifi", HTTP_POST, handleWifiPost);
  server.on("/api/wifi/state", HTTP_GET, handleWifiState);
  server.on("/update", HTTP_POST, handleUpdateDone, handleUpdateUpload);
  // Probe URLs from Android, iOS/macOS and Windows: redirecting = "there is a portal".
  for (const char* probe : {"/generate_204", "/gen_204", "/hotspot-detect.html", "/library/test/success.html",
                            "/connecttest.txt", "/ncsi.txt", "/redirect", "/canonical.html", "/success.txt"}) {
    server.on(probe, HTTP_GET, [] {
      logReq("probe");
      if (apUp) {
        server.sendHeader("Location", String("http://") + WiFi.softAPIP().toString() + "/", true);
        server.send(302, "text/plain", "");
      } else {
        server.send(204, "text/plain", "");
      }
    });
  }
  server.onNotFound([] {
    logReq("notfound");
    if (!captiveRedirect()) server.send(404, "text/plain", "not found");
  });
  server.begin();
}

void startStationServices() {
  MDNS.end();
  if (MDNS.begin(kHost)) MDNS.addService("http", "tcp", 80);
  ArduinoOTA.setHostname(kHost);
  ArduinoOTA.setMdnsEnabled(false);  // we handle mDNS ourselves (see above)
  ArduinoOTA.onStart([] {
    updateMemory(true);
    otaBusy = true;
    otaPct = 0;
  });
  ArduinoOTA.onProgress([](unsigned int cur, unsigned int total) {
    otaPct = total ? (uint8_t)((uint64_t)cur * 100 / total) : 0;
    pumpNow();
  });
  ArduinoOTA.onEnd([] { otaBusy = false; });
  ArduinoOTA.onError([](ota_error_t) {
    updateMemory(false);
    otaBusy = false;
  });
  ArduinoOTA.begin();
  configTzTime(kTz, "pool.ntp.org", "time.google.com");
  timeSynced = false;
}

void startAp() {
  if (apUp) return;
  WiFi.mode(WIFI_AP_STA);  // plus STA: needed for scanning and to keep trying the home network
  WiFi.softAP(apName);
  // Have DHCP hand out ourselves as the DNS server (off by default in IDF 5). Without DNS a phone
  // cannot look up the probe URLs and just thinks "no internet".
  const IPAddress apIp(192, 168, 4, 1);
  WiFi.softAPConfig(apIp, apIp, IPAddress(255, 255, 255, 0), IPAddress(192, 168, 4, 2), apIp);
  // Deliberately NO DHCP option 114 (RFC 8910): Android treats it as the capport API (RFC 8908, must be
  // https) and then sometimes skips its plain HTTP probe. Without option 114 Android does the classic
  // probe (generate_204) via our DNS, and we redirect that to the setup page.
  dns.setErrorReplyCode(DNSReplyCode::NoError);
  dns.start(53, "*", WiFi.softAPIP());
  apUp = true;
  apLastClient = millis();
  setMode(Mode::AccessPoint);
}

void stopAp() {
  if (!apUp) return;
  dns.stop();
  WiFi.softAPdisconnect(true);
  apUp = false;
}

void connectSta() {
  if (!ssid[0]) return;
  if (!apUp) WiFi.mode(WIFI_STA);
  WiFi.setSleep(false);  // no modem sleep: much lower latency (web UI, OTA uploads); costs some power
  WiFi.setHostname(kHost);
  WiFi.setAutoReconnect(true);
  WiFi.begin(ssid, pass);
  if (!apUp) setMode(Mode::Connecting);
}

}  // namespace

void begin(buddy::App& a) {
  app = &a;
  WiFi.persistent(false);  // we store the credentials ourselves in NVS
  WiFi.onEvent([](arduino_event_id_t e, arduino_event_info_t info) {
    if (e == ARDUINO_EVENT_WIFI_AP_STACONNECTED) Serial.println("[ap] device connected");
    if (e == ARDUINO_EVENT_WIFI_AP_STADISCONNECTED) Serial.println("[ap] device gone");
    if (e == ARDUINO_EVENT_WIFI_STA_DISCONNECTED) {
      lastReason = info.wifi_sta_disconnected.reason;
      Serial.printf("[sta] connection failed/lost, reason %d (%s)\n", lastReason, reasonText(lastReason));
    }
    if (e == ARDUINO_EVENT_WIFI_STA_GOT_IP) {
      lastReason = 0;
      Serial.printf("[sta] connected, IP %s\n", IPAddress(info.got_ip.ip_info.ip.addr).toString().c_str());
    }
    if (e == ARDUINO_EVENT_WIFI_AP_STAIPASSIGNED)
      Serial.printf("[ap] IP assigned: %s\n", IPAddress(info.wifi_ap_staipassigned.ip.addr).toString().c_str());
  });
  loadCreds();
  // Start Wi-Fi (and with it the lwIP stack) first; only then can the web server open a socket.
  WiFi.mode(ssid[0] ? WIFI_STA : WIFI_AP_STA);
  uint64_t mac = ESP.getEfuseMac();  // fixed factory MAC (WiFi.macAddress() is still empty here)
  snprintf(apName, sizeof(apName), "deskbuddy-%02X%02X", (unsigned)((mac >> 32) & 0xff),
           (unsigned)((mac >> 40) & 0xff));
  if (ssid[0]) connectSta();
  else startAp();  // first time: offer setup right away (switches off by itself after 10 min)
  startServices();
}

void loop() {
  if (mode == Mode::Off) return;
  if (servicesUp) server.handleClient();
  if (apUp) dns.processNextRequest();

  bool connected = WiFi.status() == WL_CONNECTED;
  uint32_t now = millis();

  switch (mode) {
    case Mode::Connecting:
      if (connected) {
        joining = false;
        everConnected = true;
        setMode(Mode::Station);
        startStationServices();
      } else if (!everConnected && !joining && now - modeSince > kConnectTimeout && !apUp) {
        startAp();  // never connected yet: offer setup (STA keeps trying in the background)
      } else if (now - lastRetry > 15000 && now - modeSince > 5000) {
        // Connection lost (weak signal, router restart): just retry, no setup AP.
        lastRetry = now;
        WiFi.disconnect(false);
        WiFi.begin(ssid, pass);
      }
      break;
    case Mode::AccessPoint:
      if (WiFi.softAPgetStationNum() > 0) apLastClient = now;
      if (!connected) staSince = 0;
      if (connected) {
        // Connected to the home network: keep the AP up for another 30 s so the phone sees the success.
        if (!staSince) staSince = now;
        if (now - staSince > 30000) {
          staSince = 0;
          joining = false;
          stopAp();
          WiFi.mode(WIFI_STA);
          setMode(Mode::Station);
          startStationServices();
        }
      } else if (ssid[0] && WiFi.softAPgetStationNum() == 0 && now - lastRetry > 20000) {
        lastRetry = now;  // home network known: keep trying while the setup AP is open
        WiFi.begin(ssid, pass);
      } else if (now - apLastClient > kApIdleTimeout) {
        stopAp();
        if (ssid[0]) connectSta();
        else off();
      }
      break;
    case Mode::Station:
      everConnected = true;
      ArduinoOTA.handle();
      updater::loop(connected);
      if (!timeSynced && esp_sntp_get_sync_status() == SNTP_SYNC_STATUS_COMPLETED) {
        timeSynced = true;
        board::rtcWrite(time(nullptr));
      }
      if (!connected) setMode(Mode::Connecting);  // autoReconnect handles the rest
      break;
    default:
      break;
  }
}

void setPump(void (*fn)()) { pumpFn = fn; }

void fill(buddy::DeviceInfo& d) {
  updater::fill(d);
  if (otaBusy) {  // upload via web or ArduinoOTA: same display as a GitHub update
    d.updateState = buddy::UpdateState::Installing;
    d.updateProgress = otaPct;
    snprintf(d.updateVersion, sizeof(d.updateVersion), "upload");
  }
  snprintf(d.hostname, sizeof(d.hostname), "%s", kHost);
  d.wifi = mode;
  switch (mode) {
    case Mode::Station:
      snprintf(d.ssid, sizeof(d.ssid), "%s", WiFi.SSID().c_str());
      snprintf(d.ip, sizeof(d.ip), "%s", WiFi.localIP().toString().c_str());
      d.rssi = WiFi.RSSI();
      break;
    case Mode::AccessPoint:
      snprintf(d.ssid, sizeof(d.ssid), "%s", apName);
      snprintf(d.ip, sizeof(d.ip), "%s", WiFi.softAPIP().toString().c_str());
      d.rssi = 0;
      d.apClients = WiFi.softAPgetStationNum();
      break;
    case Mode::Connecting:
      snprintf(d.ssid, sizeof(d.ssid), "%s", ssid);
      d.ip[0] = 0;
      break;
    default:
      d.ssid[0] = d.ip[0] = 0;
      break;
  }
}

void startSetupAp() {
  if (mode == Mode::Station) return;
  startAp();
}

void off() {
  stopAp();
  MDNS.end();
  WiFi.disconnect(true);
  WiFi.mode(WIFI_OFF);
  setMode(Mode::Off);
}

void join(const char* s, const char* p) {
  joining = true;
  joinStart = millis();
  lastReason = 0;
  staSince = 0;
  snprintf(ssid, sizeof(ssid), "%s", s);
  snprintf(pass, sizeof(pass), "%s", p);
  saveCreds();
  WiFi.disconnect(false);
  connectSta();
}

void action(const char* act, const char* s, const char* p, char* reply, size_t len) {
  if (!strcmp(act, "off")) {
    off();
    snprintf(reply, len, "ok wifi off");
  } else if (!strcmp(act, "on")) {
    if (ssid[0]) connectSta();
    else startAp();
    snprintf(reply, len, "ok wifi on");
  } else if (!strcmp(act, "join")) {
    join(s, p);
    snprintf(reply, len, "ok connecting to %s", s);
  } else if (!strcmp(act, "scan")) {
    // Synchronous scan (~2 s): handy over BLE, where there is no async polling.
    if (WiFi.getMode() == WIFI_OFF) WiFi.mode(WIFI_STA);
    int n = WiFi.scanNetworks(false);
    String body = "{\"networks\":[";
    int shown = 0;
    for (int i = 0; i < n && shown < 12; i++) {
      if (WiFi.SSID(i).isEmpty()) continue;
      if (shown++) body += ',';
      body += "{\"ssid\":\"";
      jsonEscape(body, WiFi.SSID(i).c_str());
      body += "\",\"rssi\":" + String(WiFi.RSSI(i)) +
              ",\"open\":" + (WiFi.encryptionType(i) == WIFI_AUTH_OPEN ? "true" : "false") + "}";
    }
    body += "]}";
    WiFi.scanDelete();
    snprintf(reply, len, "%s", body.c_str());
  } else if (!strcmp(act, "forget")) {
    ssid[0] = pass[0] = 0;
    saveCreds();
    off();
    snprintf(reply, len, "ok network forgotten");
  } else {
    buddy::DeviceInfo d;
    fill(d);
    snprintf(reply, len, "mode=%d ssid=%s ip=%s rssi=%d heap=%u", (int)d.wifi, d.ssid, d.ip, d.rssi,
             (unsigned)ESP.getFreeHeap());
  }
}

}  // namespace net
